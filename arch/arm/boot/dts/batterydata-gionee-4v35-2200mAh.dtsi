/* Copyright (c) 2013, The Linux Foundation. All rights reserved.
 *
 * This program is free software; you can redistribute it and/or modify
 * it under the terms of the GNU General Public License version 2 and
 * only version 2 as published by the Free Software Foundation.
 *
 * This program is distributed in the hope that it will be useful,
 * but WITHOUT ANY WARRANTY; without even the implied warranty of
 * MERCHANTABILITY or FITNESS FOR A PARTICULAR PURPOSE.  See the
 * GNU General Public License for more details.
 */

qcom,gionee-4v35-2200mAh-data {
	qcom,fcc-mah = <2200>;
	qcom,default-rbatt-mohm = <198>;
	qcom,rbatt-capacitive-mohm = <0>;
	qcom,flat-ocv-threshold-uv = <3800000>;
	qcom,max-voltage-uv = <4350000>;
	qcom,v-cutoff-uv = <3400000>;
	qcom,chg-term-ua = <100000>;
	qcom,batt-id-kohm = <10>;

	qcom,rbatt-sf-lut {
		qcom,lut-col-legend = <(-20) 0 25 40 60>;
		qcom,lut-row-legend = <100 95 90 85 80>,
				<75 70 65 60 55>,
				<50 45 40 35 30>,
				<25 20 16 13 11>,
				<10 9 8 7 6>,
				<5 4 3 2 1>,
				<0>;
		qcom,lut-data = <403 303 100 67 59>,
				<403 303 100 67 59>,
				<404 304 101 69 60>,
				<400 300 103 71 61>,
				<401 301 107 72 63>,
				<405 305 111 74 64>,
				<372 272 117 77 66>,
				<350 250 122 82 68>,
				<346 246 114 82 70>,
				<342 242 97 71 64>,
				<341 241 95 68 61>,
				<346 246 96 70 63>,
				<361 261 98 72 65>,
				<382 282 100 74 66>,
				<408 308 103 73 65>,
				<435 335 105 71 63>,
				<462 362 104 71 62>,
				<476 376 105 70 62>,
				<473 373 103 68 61>,
				<494 394 107 71 62>,
				<506 406 111 73 63>,
				<620 420 115 74 64>,
				<638 438 120 77 66>,
				<657 457 124 78 69>,
				<675 475 130 78 69>,
				<694 494 131 75 64>,
				<703 503 130 77 65>,
				<725 525 137 84 70>,
				<762 562 150 137 81>,
				<1257 1057 571 3818 233>,
				<41838 39838 38577 44784 19865>;
	};

	qcom,fcc-temp-lut {
		qcom,lut-col-legend = <(-20) 0 25 40 60>;
		qcom,lut-data = <2302 2297 2307 2304 2286>;
	};

	qcom,pc-temp-ocv-lut {
		qcom,lut-col-legend = <(-20) 0 25 40 60>;
		qcom,lut-row-legend = <100 95 90 85 80>,
				<75 70 65 60 55>,
				<50 45 40 35 30>,
				<25 20 16 13 11>,
				<10 9 8 7 6>,
				<5 4 3 2 1>,
				<0>;
		qcom,lut-data = <4344 4338 4336 4330 4323>,
				<4241 4261 4269 4270 4265>,
				<4172 4202 4213 4214 4210>,
				<4108 4149 4160 4160 4157>,
				<4064 4100 4109 4108 4105>,
				<3993 4055 4059 4059 4056>,
				<3928 3983 4008 4013 4011>,
				<3892 3928 3964 3972 3970>,
				<3857 3892 3921 3926 3927>,
				<3830 3859 3873 3877 3879>,
				<3810 3830 3842 3845 3845>,
				<3794 3809 3819 3821 3822>,
				<3779 3794 3799 3801 3802>,
				<3765 3784 3784 3784 3785>,
				<3751 3775 3773 3768 3763>,
				<3739 3762 3762 3751 3740>,
				<3726 3742 3743 3729 3717>,
				<3716 3718 3714 3700 3690>,
				<3706 3702 3692 3682 3671>,
				<3697 3696 3688 3680 3669>,
				<3691 3693 3687 3680 3668>,
				<3684 3691 3686 3679 3667>,
				<3676 3689 3685 3677 3666>,
				<3666 3685 3683 3672 3663>,
				<3652 3679 3678 3657 3652>,
				<3632 3665 3660 3621 3619>,
				<3603 3633 3618 3566 3568>,
				<3558 3580 3556 3490 3501>,
				<3488 3501 3473 3392 3410>,
				<3367 3377 3340 3268 3266>,
				<3000 3000 3000 3000 3000>;
	};
};
